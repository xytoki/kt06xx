//*****************************************************************************
//  File Name: LCD_KEY.c
//  Function:  KT Wireless Mic Receiver Products Demoboard
//*****************************************************************************
//        Revision History
//  Version Date        Description
//  V1.0    2012-08-28  Initial draft
//  V1.1    2013-11-22  改变变量类型定义方法
//  V1.2    2017-02-10  规范化整理
//  V1.4N   2017-04-01  根据当前是主路或者从路显示相对应的RSSI及SNR,pilot及BPSK值(Main.c)
//						把I2C的速度改快了(I2C.c)
//						根据最新的命名规则进行了版本号修改
//  V1.5     2017-04-21 在主循环里面一直读取导频和SNR的值，并根据最新的值决定是否mute(Main.c)
//  V1.6     2017-06-05 原来读写电池电压的寄存器为0x029,应该为0x0249
//						把rfIntCtl();pilotMuteRefresh();snrMuteRefresh();移到了驱动文件(Main.c)
//  V1.7     2017-06-28 增加了BATTERY_Display函数，用来显示接收机的电池电压(Main.c)
//-----------------------------------------------------------------------------
// Includes
//-----------------------------------------------------------------------------
#include "interface.h"
#include "LCD_KEY.h"
#include <intrins.h>
#include <stdio.h>

//ASCII码点阵字库
unsigned char code nAsciiDot[] =              // ASCII
{
    0x00,0x00,0x00,0x00,0x00,0x00,0x00,0x00,  // - -
    0x00,0x00,0x00,0x00,0x00,0x00,0x00,0x00,

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    0xE0,0xE0,0x20,0x20,0x20,0xE0,0xE0,0x00,
};

//-----------------------------------------------------------------------------
//函 数 名：Key_Scan
//功能描述：键盘扫描程序
//函数说明：
//全局变量：无
//输    入：无
//返    回：key_value
//设 计 者：Kanghekai               时间：2012-08-01
//修 改 者：                        时间：
//版    本：
//-----------------------------------------------------------------------------
UINT8 Key_Scan (void)
{
    INT8 key_value=0;

    if(Key_UP_A==0) // 判断是否有键按下
    {
        Delay_ms(100); // 延时去抖动
        if(Key_UP_A==0)
            key_value=1;
    }
    else if(Key_DOWN_A==0) // 判断是否有键按下
    {
        Delay_ms(100); // 延时去抖动
        if (Key_DOWN_A==0)    
            key_value=2;
    }
    else if(Key_SET_A==0) // 判断是否有键按下
    {
        Delay_ms(100); // 延时去抖动
        if (Key_SET_A==0)    
            key_value=3;
    }
    else if(Key_UP_B==0) // 判断是否有键按下
    {
        Delay_ms(100); // 延时去抖动
        if(Key_UP_B==0)
            key_value=4;
    }
    else if(Key_DOWN_B==0) // 判断是否有键按下
    {
        Delay_ms(100); // 延时去抖动
        if (Key_DOWN_B==0)    
            key_value=5;
    }
    else if(Key_SET_B==0) // 判断是否有键按下
    {
        Delay_ms(100); // 延时去抖动
        if (Key_SET_B==0)    
            key_value=6;
    }
    else
        key_value=0;
    return(key_value);
}

//-----------------------------------------------------------------------------
//函 数 名：Delay_ms
//功能描述：ms级延时
//函数说明：
//全局变量：无
//输    入：iTime_Number
//返    回：无
//设 计 者：Kanghekai               时间：2012-08-01
//修 改 者：                        时间：
//版    本：
//-----------------------------------------------------------------------------
void Delay_ms(UINT16 iTime_Number)
{
    UINT16 i;
    UINT16 j;

    for (j=0;j<iTime_Number;j++)
    {
        for (i=0;i<0x400;i++) // 1ms@12M
        {
        }
    }
}

//-----------------------------------------------------------------------------
//函 数 名：Delay_us                                                              
//功能描述：us级延时                                                             
//函数说明：                                                                     
//全局变量：无                                                                     
//输    入：iTime_Number                                                                     
//返    回：无                                                                     
//设 计 者：ZDF                     时间：2012-08-01                                         
//修 改 者：                        时间：                                         
//版    本：                                                                     
//-----------------------------------------------------------------------------
void Delay_us(UINT8 iTime_Number)
{
    UINT8 i;

    for(i=0;i<=iTime_Number;i++)  //1us@12Mhz,iTime_Number越大越准确
    {
        _nop_();
		_nop_();
    }
}

//-----------------------------------------------------------------------------
//函 数 名：transfer_command
//功能描述：写指令到LCD 模块
//函数说明：
//全局变量：无
//输    入：UINT8 data1
//返    回：无
//设 计 者：PAE                     时间：2012-08-01
//修 改 者：                        时间：
//版    本：V1.0
//-----------------------------------------------------------------------------
void transfer_command(UINT8 data1)
{
    char i;
    
    LCD_CS=0;
    LCD_RS=0;
    for(i=0;i<8;i++)
    {
        LCD_SCL=0;
        if(data1&0x80)
        { 
            LCD_SDA=1;
        }
        else
        { 
            LCD_SDA=0;
        }
        LCD_SCL=1;
        data1=data1<<=1;
    }
    LCD_CS=1;
}

//-----------------------------------------------------------------------------
//函 数 名：delay
//功能描述：延时函数
//函数说明：
//全局变量：无
//输    入：i
//返    回：无
//设 计 者：Kanghekai               时间：2012-08-01
//修 改 者：                        时间：
//版    本：V1.0
//-----------------------------------------------------------------------------
void delay(int i)
{
    int j,k;
    
    for(j=0;j<i;j++)
        for(k=0;k<110;k++);
}

//-----------------------------------------------------------------------------
//函 数 名：transfer_data
//功能描述：写数据到LCD 模块
//函数说明：
//全局变量：无
//输    入：int data1
//返    回：无
//设 计 者：PAE                     时间：2012-08-01
//修 改 者：                        时间：
//版    本：V1.0
//-----------------------------------------------------------------------------
void transfer_data(int data1)
{
    char i;
    
    LCD_CS=0;
    LCD_RS=1;
    for(i=0;i<8;i++)
    {
        LCD_SCL=0;
        if(data1&0x80) 
            LCD_SDA=1;
        else LCD_SDA=0;
            LCD_SCL=1;
        data1=data1<<=1;
    }
    LCD_CS=1;
}

//-----------------------------------------------------------------------------
//函 数 名：lcd_address
//功能描述：设置LCD中page column的地址
//函数说明：
//全局变量：无
//输    入：UINT8 page,UINT8 column
//返    回：无
//设 计 者：PAE                     时间：2012-08-01
//修 改 者：                        时间：
//版    本：V1.0
//-----------------------------------------------------------------------------
void lcd_address(UINT8 page,UINT8 column)
{
    column=column-1; //我们平常所说的第1列，在LCD驱动IC里是第0列。所以在这里减去1.

    //设置页地址。每页是8 行。一个画面的64 行被分成8 个页。我们平常所说的第1 页，
    //在LCD 驱动IC 里是第0页，所以在这里减去1    
    page=page-1;

    transfer_command(0xb0+page); 
    transfer_command(((column>>4)&0x0f)+0x10); //设置列地址的高4 位
    transfer_command(column&0x0f); //设置列地址的低4 位
}

//-----------------------------------------------------------------------------
//函 数 名：clear_screen
//功能描述：全屏清屏
//函数说明：
//全局变量：无
//输    入：无
//返    回：无
//设 计 者：PAE                     时间：2012-08-01
//修 改 者：                        时间：
//版    本：V1.0
//-----------------------------------------------------------------------------
void clear_screen()
{
    unsigned char i,j;
    
    for(i=0;i<9;i++)
    {
        lcd_address(1+i,1);
        for(j=0;j<128;j++)
        {
            transfer_data(0x00);
        }
    }
}

//-----------------------------------------------------------------------------
//函 数 名：LCD_Init
//功能描述：LCD 模块初始化
//函数说明：
//全局变量：无
//输    入：无
//返    回：无
//设 计 者：PAE                     时间：2012-08-01
//修 改 者：                        时间：
//版    本：V1.0
//-----------------------------------------------------------------------------
void LCD_Init()
{
    LCD_RST=0; //低电平复位
    delay(800);
    LCD_RST=1; //复位完毕
    delay(800);
    transfer_command(0xe2); //软复位
    delay(500);
    transfer_command(0x2f); //打开内部升压
    delay(500);
    transfer_command(0x81); //微调对比度
    transfer_command(0x38); //微调对比度的值，可设置范围0x00～0xFF(原值0X38）
    transfer_command(0xeb); //1/9 偏压比（bias）
    transfer_command(0x40);
    transfer_command(0xc6); //行列扫描顺序：从上到下、从左到右
    transfer_command(0xaf); //开显示
    clear_screen();            //清屏
    display_ascii_string(0,0,"F:      F:");    //频率
    display_ascii_string(1,0,"V:      V:");    //电量
    display_ascii_string(2,0,"S:      S:");    //RSSI
    display_ascii_string(3,0,"A:      A:");    //音量
}

//-----------------------------------------------------------------------------
//函 数 名：display_graphic_8x16
//功能描述：显示8x16 点阵图像、ASCII, 或8x16 点阵的自造字符、其他图标
//函数说明：
//全局变量：无
//输    入：UINT8 page,UINT8 column,UINT8 *dp
//返    回：无
//设 计 者：PAE                     时间：2012-08-01
//修 改 者：                        时间：
//版    本：V1.0
//-----------------------------------------------------------------------------
void display_graphic_8x16(UINT8 page,UINT8 column,UINT8 *dp)
{
    UINT8 i,j;
    if(column>=120)
        column=120;
    if(page>=8)
        page=8;
    page=8-page;
//    column=120-column;
    j=2;
    do
    {
        j--;
        for (i=0;i<=7;i++)
        {
            lcd_address(page+j,column+i);
            transfer_data(*dp); //写数据到LCD,每写完一个8 位的数据后列地址自动加1
            dp++;
//            if(i==0)
//            break;
        }
    }while(j);
}

//-----------------------------------------------------------------------------
//函 数 名：display_ascii_string
//功能描述：显示ASCII串
//函数说明：
//全局变量：无
//输    入：UINT8 x,UINT8 y,UINT8 *text
//返    回：无
//设 计 者：PAE                     时间：2012-08-01
//修 改 者：                        时间：
//版    本：V1.0
//-----------------------------------------------------------------------------
void display_ascii_string(UINT8 x,UINT8 y,UINT8 *text)
{
    UINT8 data i= 0;
    
    while(1)
    {
        if(text[i]==0)
            return;
        display_graphic_8x16(2*x+1,(y+i)*8+1,nAsciiDot+(text[i]-32)*16);
        i++;            
    }
}

